## chryusb/class/hid/Kconfig
```kconfig
config CHERRYUSB_CLASS_HID
	bool "CherryUSB HID Class"
	help
	  This option enables the 'HID' library
```

## west.yml
```yaml
manifest:
  remotes:
    - name: zephyrproject-rtos
      url-base: https://github.com/zephyrproject-rtos
    - name: D-Veda
      url-base: https://github.com/D-Veda
  projects:
    - name: zephyr
      remote: zephyrproject-rtos
      revision: main
      import:
        name-allowlist:
          - cmsis
          - hal_nxp
    - name: CherryUSB
      remote: D-Veda
      revision: master
      path: modules/CherryUSB
  self:
    path: application
  version: "1.2"
```
